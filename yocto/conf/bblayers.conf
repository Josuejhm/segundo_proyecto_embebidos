## yocto/conf/bblayers.conf
```bitbake
LCONF_VERSION = "7"
BBPATH = "${TOPDIR}"

BBLAYERS ?= " \
  /yocto/layers/poky/meta \
  /yocto/layers/poky/meta-poky \
  /yocto/layers/poky/meta-yocto-bsp \
  /yocto/layers/meta-openembedded/meta-oe \
  /yocto/layers/meta-openembedded/meta-python \
  /yocto/layers/meta-openembedded/meta-networking \
  /yocto/layers/meta-openembedded/meta-multimedia \
  /yocto/layers/meta-tegra \
  /yocto/layers/meta-clang \
  "
```
